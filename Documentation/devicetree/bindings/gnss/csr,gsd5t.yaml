## Documentation/devicetree/bindings/gnss/csr,gsd5t.yaml
```yaml
# SPDX-License-Identifier: (GPL-2.0-only OR BSD-2-Clause)
%YAML 1.2
---
$id: http://devicetree.org/schemas/gnss/csr,gsd5t.yaml#
$schema: http://devicetree.org/meta-schemas/core.yaml#

title: CSR GSD5T GNSS Receiver

maintainers:
  - Svyatoslav Ryhel <clamor95@gmail.com>

description:
  CSR-based GNSS receiver which uses a serial interface.

allOf:
  - $ref: gnss-common.yaml#

properties:
  compatible:
    const:
      - csr,gsd5t

  vcc-supply:
    description:
      Main voltage supply, typically connected a 1.8V supply.

  vio-supply:
    description:
      IO voltage supply, typically 1.8V

  power-gpios:
    description: An optional power GPIO line, it should be
      tagged GPIO_ACTIVE_HIGH.

  reset-gpios:
    description: An optional active low reset line, should
      be flagged with GPIO_ACTIVE_LOW.

  clocks:
    maxItems: 1

  clock-names:
    const: ref_clk

required:
  - compatible

unevaluatedProperties: false

examples:
  - |
    #include <dt-bindings/gpio/gpio.h>

    serial {
        gnss {
            compatible = "csr,gsd5t";
            current-speed = <115200>;

            clocks = <&gps_osc>;
            clock-names = "ref_clk";

            power-gpios = <&gpio TEGRA_GPIO(R, 6) GPIO_ACTIVE_HIGH>;

            vcc-supply = <&vcc_1v8_gps>;
            vio-supply = <&vdd_1v8_vio>;
        };
    };
```

## Documentation/devicetree/bindings/media/i2c/ovti,ov9726.yaml
```yaml
# SPDX-License-Identifier: (GPL-2.0-only OR BSD-2-Clause)
%YAML 1.2
---
$id: http://devicetree.org/schemas/media/i2c/ovti,ov9726.yaml#
$schema: http://devicetree.org/meta-schemas/core.yaml#

title: OmniVision OV9726 720p HD CMOS Image Sensor

maintainers:
  - Svyatoslav Ryhel <clamor95@gmail.com>

description:
  OV9726 sensor is an OmniVision CMOS active pixel digital image sensor with an
  active array size of 1296H x 808V. It is programmable through I2C interface.
  Image data is sent through MIPI CSI-2 (1 lane) or DVP.

allOf:
  - $ref: /schemas/media/video-interface-devices.yaml#

properties:
  compatible:
    const: ovti,ov9726

  reg:
    maxItems: 1

  clocks:
    description: XVCLK with possible frequency from 6 to 27 MHz
    maxItems: 1

  reset-gpios:
    maxItems: 1

  powerdown-gpios:
    description: optional PWDN GPIO (active high)
    maxItems: 1

  evdd-supply:
    description: Core power supply (1.5V - 1.8V)

  dovdd-supply:
    description: Digital IO power supply (1.7V - 3.0V)

  avdd-supply:
    description: Analog power supply (2.6V - 3.0V)

  port:
    additionalProperties: false
    $ref: /schemas/graph.yaml#/$defs/port-base

    properties:
      endpoint:
        $ref: /schemas/media/video-interfaces.yaml#
        unevaluatedProperties: false

        properties:
          data-lanes: true
          bus-type: true
          link-frequencies: true

        required:
          - bus-type
          - link-frequencies

    required:
      - endpoint

required:
  - compatible
  - reg
  - clocks
  - reset-gpios
  - port

unevaluatedProperties: false

examples:
  - |
    #include <dt-bindings/gpio/gpio.h>
    #include <dt-bindings/media/video-interfaces.h>

    i2c {
        #address-cells = <1>;
        #size-cells = <0>;

        camera@10 {
            compatible = "ovti,ov9726";
            reg = <0x10>;

            clocks = <&ov9726_clk>;

            evdd-supply = <&camera_evdd_1v5>;
            dovdd-supply = <&camera_iovdd_1v8>;
            avdd-supply = <&camera_avdd_2v7>;

            reset-gpios = <&gpio 223 GPIO_ACTIVE_LOW>;

            orientation = <0>;
            rotation = <90>;

            port {
                ov9726_output: endpoint {
                    data-lanes = <1>;
                    bus-type = <MEDIA_BUS_TYPE_CSI2_DPHY>;
                    link-frequencies = /bits/ 64 <480000000>;
                    remote-endpoint = <&csi_input>;
                };
            };
        };
    };
...
```
